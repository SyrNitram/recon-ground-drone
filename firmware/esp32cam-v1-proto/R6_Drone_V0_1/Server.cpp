// Recon Ground Drone - adapted file
// Original code (c) 2022-2023 Martin RYS, released under the MIT License.
// Adapted from: robotzero.one ESP32-CAM RC Car
//   https://robotzero.one/esp32-cam-rc-car/  |  https://github.com/robotzero1/esp32cam-rc-car
// NOTE: This firmware links ArduinoWebsockets (GPL-3.0); any compiled/distributed
//       binary is therefore covered by GPL-3.0. See LICENSE and THIRD_PARTY.md.

//WEBSERVER AND HTML
//https://robotzero.one/esp32-cam-rc-car/
//https://robotzero.one/esp32-cam-rc-car/
//https://robotzero.one/esp32-cam-rc-car/
//DECODE HTML : https://gchq.github.io/CyberChef/#recipe=Find_/_Replace(%7B'option':'Regex','string':','%7D,'',true,false,false,false)Remove_whitespace(true,false,true,false,false,false)From_Hex('0x')Gunzip()
//ENCODE HTML : https://gchq.github.io/CyberChef/#recipe=Gzip('Dynamic%20Huffman%20Coding','index.html.gz','',false)To_Hex('0x',0)Split('0x',',0x')


#include <ArduinoWebsockets.h>
#include <WiFi.h>
#include <ESPAsyncWebServer.h>
#include "esp_camera.h"
#include "Server.h"
#include "Motor_ctrl.h"

//Global variable ==========================================================================================

//Wifi Config
const char* ssid = "YOUR_WIFI_SSID"; //Enter SSID
const char* password = "YOUR_WIFI_PASSWORD"; //Enter Password

//WebServer
const uint8_t index_html_gz[] = {0x1f, 0x8b, 0x08, 0x08, 0xf8, 0x06, 0x48, 0x63, 0x00, 0xff, 0x69, 0x6e, 0x64,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 0x00
                                };
using namespace websockets;
WebsocketsServer server;
AsyncWebServer webserver(80);

//Camera settings
camera_fb_t * fb = NULL;


//Private functions ==========================================================================================
//WebServer ----------------------------------------------------------------------------------------------------
void handle_message(WebsocketsMessage msg) {
  int commaIndex = msg.data().indexOf(',');
  int x = msg.data().substring(0, commaIndex).toInt();
  int y = msg.data().substring(commaIndex + 1).toInt();

  Motor_setCommand((float)x, (float)y);

  if (DEBUG_WS) {
    Serial.print(" t: ");
    Serial.print(millis());
    Serial.print(" |  Received -> steer : ");
    Serial.print(x );
    Serial.print("   fw :  ");
    Serial.print(y );
    Serial.println(" ");
  }
}



//Public functions ==========================================================================================
//Wifi Config --------------------------------------------------------------------------------------------------

int Wifi_init() {
  // Connect to wifi
  WiFi.begin(ssid, password);

  // Wait some time to connect to wifi
  for (int i = 0; i < 15 && WiFi.status() != WL_CONNECTED; i++) {
    if (DEBUG_WIFI)     Serial.print(".");
    delay(1000);
  }

  if (WiFi.status() != WL_CONNECTED) {
    if (DEBUG_WIFI) {
      Serial.println("");
      Serial.println("WiFi connection timed out");
    }
    return 1;
  }

  else {
    if (DEBUG_WIFI) {
      Serial.println("");
      Serial.println("WiFi connected");
      Serial.println("IP address: ");
      Serial.println(WiFi.localIP());   // You can get IP address assigned to ESP
    }
    return 0;
  }
}

//WebServer ------------------------------------------------------------------------------------------------------

int WebServer_init() {
  webserver.on("/", HTTP_GET, [](AsyncWebServerRequest * request) {
    AsyncWebServerResponse *response = request->beginResponse_P(200, "text/html", index_html_gz, sizeof(index_html_gz));
    response->addHeader("Content-Encoding", "gzip");
    request->send(response);
  });

  webserver.begin();
  server.listen(82);

  if (DEBUG_WS) {
    Serial.print("Is server live? ");
    Serial.println(server.available());
  }
  return server.available();
}

void Connection_handler() {
  unsigned long t = millis();
  auto client = server.accept();
  client.onMessage(handle_message);
  while (client.available()) {
    if(millis()-t > 200){
      t=millis();
      //Leds_update();
    }
    
    client.poll();
    fb = esp_camera_fb_get();
    client.sendBinary((const char *)fb->buf, fb->len);
    esp_camera_fb_return(fb);
    fb = NULL;
  }
}


//Camera settings -----------------------------------------------------------------------------------------------
#define PWDN_GPIO_NUM     32
#define RESET_GPIO_NUM    -1
#define XCLK_GPIO_NUM      0
#define SIOD_GPIO_NUM     26
#define SIOC_GPIO_NUM     27
#define Y9_GPIO_NUM       35
#define Y8_GPIO_NUM       34
#define Y7_GPIO_NUM       39
#define Y6_GPIO_NUM       36
#define Y5_GPIO_NUM       21
#define Y4_GPIO_NUM       19
#define Y3_GPIO_NUM       18
#define Y2_GPIO_NUM        5
#define VSYNC_GPIO_NUM    25
#define HREF_GPIO_NUM     23
#define PCLK_GPIO_NUM     22

int Camera_init() {
  camera_config_t config;
  config.ledc_channel = LEDC_CHANNEL_0;
  config.ledc_timer = LEDC_TIMER_0;
  config.pin_d0 = Y2_GPIO_NUM;
  config.pin_d1 = Y3_GPIO_NUM;
  config.pin_d2 = Y4_GPIO_NUM;
  config.pin_d3 = Y5_GPIO_NUM;
  config.pin_d4 = Y6_GPIO_NUM;
  config.pin_d5 = Y7_GPIO_NUM;
  config.pin_d6 = Y8_GPIO_NUM;
  config.pin_d7 = Y9_GPIO_NUM;
  config.pin_xclk = XCLK_GPIO_NUM;
  config.pin_pclk = PCLK_GPIO_NUM;
  config.pin_vsync = VSYNC_GPIO_NUM;
  config.pin_href = HREF_GPIO_NUM;
  config.pin_sscb_sda = SIOD_GPIO_NUM;
  config.pin_sscb_scl = SIOC_GPIO_NUM;
  config.pin_pwdn = PWDN_GPIO_NUM;
  config.pin_reset = RESET_GPIO_NUM;
  config.xclk_freq_hz = 20000000;
  config.pixel_format = PIXFORMAT_JPEG;

  //init with high specs to pre-allocate larger buffers
  if (psramFound()) {
    config.frame_size = FRAMESIZE_UXGA;
    config.jpeg_quality = 10;
    config.fb_count = 2;
  } else {
    config.frame_size = FRAMESIZE_SVGA;
    config.jpeg_quality = 12;
    config.fb_count = 1;
  }

  // camera init
  esp_err_t err = esp_camera_init(&config);
  if (err != ESP_OK) {
    if (DEBUG_CAM) Serial.printf("Camera init failed with error 0x%x", err);
    return 1;
  }

  sensor_t * s = esp_camera_sensor_get();
  s->set_framesize(s, FRAMESIZE_VGA);
  s->set_vflip(s, 1);

  return 0;
}
